## conf/layer.conf
```bitbake
# We have a conf and classes directory, add to BBPATH
BBPATH .= ":${LAYERDIR}"

# We have recipes-* directories, add to BBFILES
BBFILES += "${LAYERDIR}/recipes-*/*/*.bb \
            ${LAYERDIR}/recipes-*/*/*.bbappend"

BBFILE_COLLECTIONS += "meta-rukinia"
BBFILE_PATTERN_meta-rukinia = "^${LAYERDIR}/"
BBFILE_PRIORITY_meta-rukinia = "7"

LAYERDEPENDS_meta-rukinia = "core"
LAYERSERIES_COMPAT_meta-rukinia = "scarthgap walnascar styhead"
```
